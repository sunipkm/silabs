## Kconfig
```kconfig
#
# SiLabs 446x char driver config
#

menuconfig SILABS_CHAR_DRIVERS
	bool "SiLabs UHF Transceiver Drivers"
	help
	  SiLab's Si446x Modem Char Interface

if SILABS_CHAR_DRIVERS

config SI446X_DEV
	bool "Si446x Driver"
        default m
        help
          Driver for communication using Si446x transceiver.

endif
```
